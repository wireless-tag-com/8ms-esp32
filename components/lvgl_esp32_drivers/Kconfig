## components/qmsd_board/Kconfig.projbuild
```kconfig
menu "QMSD Hal"
    choice QMSD_BOARD
        prompt "QMSD Board"
        default ZX3D50CE02S_USRC_4832
        help
            Select an board to use with the qmsd sdk
        config QMSD_BOARD_CUSTOM
            bool "Custom QMSD Board"
        config ZX3D50CE02S_USRC_4832
            bool "ZX3D50CE02S_USRC_4832"
        config ZX3D95CE01S_UR
            bool "ZX3D95CE01S_UR"
        config ZX3D95CE01S_AR
            bool "ZX3D95CE01S_AR"
        config ZX4D30NS
            bool "ZX4D30NS"
    endchoice

    choice QMSD_SCREEN_ROTATION
        prompt "QMSD Screen Rotation" 
        default QMSD_SCREEN_ROTATION_0
        config QMSD_SCREEN_ROTATION_0
            bool "Rotate 0 Degree"
        config QMSD_SCREEN_ROTATION_90
            bool "Rotate 90 Degree"
        config QMSD_SCREEN_ROTATION_180
            bool "Rotate 180 Degree"
        config QMSD_SCREEN_ROTATION_270
            bool "Rotate 270 Degree"
    endchoice

    config QMSD_BOARD_TOUCH_EN
        bool "Enable Touch Initialization"
        default y

    menu "QMSD Touch Config"
        depends on QMSD_BOARD_TOUCH_EN
        config QMSD_TOUCH_I2C_FREQ
            int "Touch i2c driver speed"
            default 400000
        config QMSD_TOUCH_THREAD_EN
            bool "Touch read in thread"
            default y
        config QMSD_TOUCH_THREAD_PRIORITY
            int "Touch read thread priority"
            default 5
        config QMSD_TOUCH_THREAD_CORE
            int "Touch read thread core"
            default 0
    endmenu

    config QMSD_BOARD_GUI_EN
        bool "Enable Gui initialization"
        default y

    menu "QMSD Gui Config"
        depends on QMSD_BOARD_GUI_EN
        config QMSD_GUI_DOUBLE_BUFFER
            bool "Gui enable double buffer"
            default y
        config QMSD_GUI_BUFFER_IN_PSRAM
            bool "Gui buffers in psram"
            default y
        config QMSD_GUI_BUFFER_SIZE
            int "Gui buffer size, 0 refers to the full screen buffer"
            default 0
        config QMSD_GUI_REFRESH_THREAD_EN
            bool "Gui enable refresh in thread"
            default y
        config QMSD_GUI_REFRESH_THREAD_PRIORITY
            depends on QMSD_GUI_REFRESH_THREAD_EN
            int "Gui refresh thread priority"
            default 5
        config QMSD_GUI_REFRESH_THREAD_CORE
            depends on QMSD_GUI_REFRESH_THREAD_EN
            int "Gui refresh thread core"
            default 0

        config QMSD_GUI_UPDATE_THREAD_EN
            bool "Gui enable update thread"
            default y
        config QMSD_GUI_UPDATE_THREAD_PRIORITY
            depends on QMSD_GUI_UPDATE_THREAD_EN
            int "Gui update thread priority"
            default 5
        config QMSD_GUI_UPDATE_THREAD_CORE
            depends on QMSD_GUI_UPDATE_THREAD_EN
            int "Gui update thread core"
            default 0
    endmenu

    menu "IDF-5.0 Adaptation"
        config I2S_SUPPRESS_DEPRECATE_WARN
            bool "I2S disable i2s.h deprecate warn"
            default y
    endmenu

endmenu
 
```

## components/qmsd_init/Kconfig
```kconfig
menu "Qmsd board select"
    
    choice WT_BOARD
        prompt "Select borad"
        default WT32_SC01
        config WT32_SC01
            bool "WT32_SC01"
        config WT154_S2MI1
            bool "WT154_S2MI1"
        config WT154_C3SI1
            bool "WT154_C3SI1"
        config WT_86_32_3ZW0
            bool "WT_86_32_3ZW0"
        config WT_86_32_3ZW1
            bool "WT_86_32_3ZW1"
        config WT280_S2MX1
            bool "WT280_S2MX1"
        config WT240_C3SI1
            bool "WT240_C3SI1"
        config WT_0_S2_240MW1
            bool "WT-0-S2-240MW1"
        config ZX4D30NE01S_UR_4827
            bool "ZX4D30NE01S-UR-4827"
        config ZX3D95CE01S_UR_4848
            bool "ZX3D95CE01S-UR-4848"
        config ZX3D95CE01S_AR_4848
            bool "ZX3D95CE01S-AR-4848"
        config ZX3D50CE02S_USRC_4832
            bool "ZX3D50CE02S-USRC-4832"
        config ZX3D92CE01S_cGS01_AR_3232
            bool "ZX3D92CE01S-cGS01-AR-3232"
        config ZX2D10ECS_cESCP01
            bool "ZX2D10ECS-cESCP01"
        config ZX4D60_AR_4896
            bool "ZX4D60_AR_4896"
        config ZX210_S3MLW1
            bool "ZX210_S3MLW1"
        config CUSTOM_LCD
            bool "CUSTOM_LCD"
    endchoice

    choice SCREEN_TORATION
        prompt "Screen totation"
        default SCREEN_ROLL_0
        config SCREEN_ROLL_0
            bool "0°"
        config SCREEN_ROLL_1
            bool "180°"
        config SCREEN_ROLL_2
            bool "90°"
        config SCREEN_ROLL_3
            bool "270°"
    endchoice
endmenu
```

## components/screen/Kconfig
```kconfig
menu "LCD Drivers"

    menu "Select Screen Controller"
        config LCD_DRIVER_SCREEN_CONTROLLER_ILI9341
            bool "ILI9341"
            default y
        config LCD_DRIVER_SCREEN_CONTROLLER_ILI9342
            bool "ILI9342"
            default y
        config LCD_DRIVER_SCREEN_CONTROLLER_ILI9486
            bool "ILI9486"
            default y
        config LCD_DRIVER_SCREEN_CONTROLLER_ILI9806
            bool "ILI9806"
            default y
        config LCD_DRIVER_SCREEN_CONTROLLER_ILI9488
            bool "ILI9488"
            default y
        config LCD_DRIVER_SCREEN_CONTROLLER_NT35510
            bool "NT35510"
            default y
        config LCD_DRIVER_SCREEN_CONTROLLER_RM68120
            bool "RM68120"
            default y
        config LCD_DRIVER_SCREEN_CONTROLLER_SSD1351
            bool "SSD1351"
            default y
        config LCD_DRIVER_SCREEN_CONTROLLER_SSD1963
            bool "SSD1963"
            default y
        config LCD_DRIVER_SCREEN_CONTROLLER_ST7789
            bool "ST7789"
            default y
        config LCD_DRIVER_SCREEN_CONTROLLER_ST7796
            bool "ST7796"
            default y
        
        config LCD_DRIVER_SCREEN_CONTROLLER_SSD1306
            bool "SSD1306"
            default y
        config LCD_DRIVER_SCREEN_CONTROLLER_SSD1307
            bool "SSD1307"
            default y
        config LCD_DRIVER_SCREEN_CONTROLLER_SSD1322
            bool "SSD1322"
            default y
    endmenu
endmenu
```
